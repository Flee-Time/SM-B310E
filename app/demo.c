/*
 * B310E-OS — app/demo.c
 *
 * Demo tasks for the first integrated boot: an LCD banner + heartbeat task
 * and a keypad task that echoes key presses to the USB debug channel and
 * the LCD.
 *
 * COOPERATIVE SCHEDULING (READ THIS): the scheduler has no preemption —
 * every task MUST call task_yield() in its loop, or it starves all other
 * tasks (and the phone appears hung). Both tasks below yield once per
 * iteration.
 *
 * Boot order contract (arch/main.c): sc6530_chip_init() -> kmem_init() ->
 * module_register(lcd/keypad/usb_debug) -> module_init_all() ->
 * task_create() -> sched_start(). Tasks only run after sched_start(), so
 * module_init_all() is guaranteed complete before the first kprintf (the
 * usb_debug module installed the strong kputc -> USB) or LCD write.
 *
 * HOST TESTS: app/ is intentionally NOT in HOSTTEST_SRCS (the host build
 * compiles tests/hosttest.c + the kernel sources only). App code is
 * ARM-only; host tests cover the pure kernel/driver logic.
 */

#include "os.h"

#include <stdarg.h>

#include "build_time.h"     /* generated by the Makefile (compile stamp) */

#include "../drivers/lcd.h"
#include "../drivers/keypad.h"
#include "../drivers/led.h"
#include "../drivers/usb_debug.h"
#include "../drivers/sdio.h"
#include "../drivers/microfat.h"
#include "../drivers/battery.h"
#include "../drivers/rtc.h"
#include "../drivers/audio.h"
#include "demo.h"

/* ---- LCD banner + heartbeat -------------------------------------------- */

/* Varargs wrapper: kernel vsnprintf takes a va_list (no libc printf). */
static int demo_snprintf(char *buf, size_t n, const char *fmt, ...)
{
    va_list ap;
    int r;

    va_start(ap, fmt);
    r = vsnprintf(buf, n, fmt, ap);
    va_end(ap);
    return r;
}

/* Field-by-field rtc_time_t comparison (a < b). */
static int demo_rtc_less(const rtc_time_t *a, const rtc_time_t *b)
{
    if (a->year != b->year) return a->year < b->year;
    if (a->month != b->month) return a->month < b->month;
    if (a->day != b->day) return a->day < b->day;
    if (a->hour != b->hour) return a->hour < b->hour;
    if (a->minute != b->minute) return a->minute < b->minute;
    return a->second < b->second;
}

/* The RTC's battery-less boot state is garbage (HW-verified: year 85 /
 * month 21 / 17:40 — the user sees this on EVERY boot) — treat any
 * impossible date/time as the corrupted/zeroed state. */
static int demo_rtc_valid(const rtc_time_t *t)
{
    return t->month >= 1u && t->month <= 12u &&
           t->day >= 1u && t->day <= 31u &&
           t->hour <= 23u && t->minute <= 59u && t->second <= 59u;
}

/* QoL: a battery removal resets the RTC to its corrupted factory default.
 * If the RTC is behind the COMPILE time OR its date is impossible,
 * bootstrap it to the build date/time so the phone has a sane clock until
 * a real source sets it. */
static void demo_rtc_build_boot(void)
{
    rtc_time_t now, bt;
    int rc;

    bt.year   = BUILD_TIME_YEAR - 2000u;   /* RTC year is 2000 + 0..99 */
    bt.month  = BUILD_TIME_MONTH;
    bt.day    = BUILD_TIME_DAY;
    bt.hour   = BUILD_TIME_HOUR;
    bt.minute = BUILD_TIME_MIN;
    bt.second = BUILD_TIME_SEC;

    if (rtc_get_time(&now) != 0) {
        kprintf("rtc: build-boot read failed\n");
        return;
    }
    if (demo_rtc_less(&now, &bt) || !demo_rtc_valid(&now)) {
        rc = rtc_set_time(&bt);
        kprintf("rtc: now %u-%02u-%02u %02u:%02u:%02u (corrupt/behind) set to build time %u-%02u-%02u %02u:%02u:%02u rc=%d\n",
                (unsigned)(2000u + now.year), (unsigned)now.month,
                (unsigned)now.day, (unsigned)now.hour, (unsigned)now.minute,
                (unsigned)now.second, (unsigned)(2000u + bt.year),
                (unsigned)bt.month, (unsigned)bt.day, (unsigned)bt.hour,
                (unsigned)bt.minute, (unsigned)bt.second, rc);
    } else {
        kprintf("rtc: ok %u-%02u-%02u %02u:%02u:%02u\n",
                (unsigned)(2000u + now.year), (unsigned)now.month,
                (unsigned)now.day, (unsigned)now.hour, (unsigned)now.minute,
                (unsigned)now.second);
    }
}

/* ---- battery readout (top bar): crude icon + small-font mV ------------- */

/* True while RSOFT is HELD (the 16-channel grid is showing) — the banner
 * skips its per-second redraw so it never draws over the grid. */
static volatile int s_rsoft_grid;

/* Crude battery icon at the top-right corner: a 24x13 outline with a
 * terminal nub, filled left-to-right proportional to the level. Fill
 * green while charging, else green/yellow/red by level. */
static void demo_draw_battery_icon(uint32_t pct, int charging)
{
    int bx = 100, by = 1, bw = 24, bh = 12, i, j;
    uint16_t col = charging ? 0x07e0u
                   : (pct > 50 ? 0x07e0u : (pct > 20 ? 0xffe0u : 0xf800u));
    int fill = (int)((bw - 2) * (int)pct / 100);
    if (fill > bw - 2)
        fill = bw - 2;

    for (i = 0; i <= bh; i++)           /* clear the icon + nub area */
        for (j = 0; j < bw + 2; j++)
            lcd_fb[(by + i) * LCD_W + (bx + j)] = 0x0000;
    for (i = 3; i < bh - 3; i++)        /* terminal nub (right) */
        lcd_fb[(by + i) * LCD_W + (bx + bw)] = 0xffff;
    for (i = 0; i <= bh; i++)           /* outline */
        for (j = 0; j < bw; j++)
            if (i == 0 || i == bh || j == 0 || j == bw - 1)
                lcd_fb[(by + i) * LCD_W + (bx + j)] = 0xffff;
    for (i = 1; i < bh; i++)            /* level fill */
        for (j = 1; j <= fill; j++)
            lcd_fb[(by + i) * LCD_W + (bx + j)] = col;
}

/* ---- scrolling console (the LCD shows kprintf even without USB) -------- */

#define CON_COLS   21                     /* 128 / 6px cell pitch          */
#define CON_ROWS   16                     /* (160 - 16) / 9px row pitch    */
#define CON_Y0     16
#define CON_CH_W   6
#define CON_PITCH  9

static char s_con[CON_ROWS][CON_COLS + 1];
static char s_con_pending[CON_COLS * 4 + 1];
static unsigned s_con_pending_len;
static int s_con_dirty;

static void demo_con_scroll(void)
{
    unsigned r, i;

    for (r = 0; r + 1 < CON_ROWS; r++)
        for (i = 0; i <= CON_COLS; i++)
            s_con[r][i] = s_con[r + 1][i];
}

/* Push one (possibly long) kprintf line: wrap into CON_COLS-wide chunks and
 * scroll the console up by one row per chunk. */
static void demo_con_push(const char *line)
{
    unsigned pos = 0;

    for (;;) {
        char chunk[CON_COLS + 1];
        unsigned n = 0;

        while (line[pos] && n < CON_COLS)
            chunk[n++] = line[pos++];
        while (n <= CON_COLS)           /* zero the tail: a short line must
                                           leave the rest of the row empty,
                                           not stack garbage (the ghost
                                           glyphs) */
            chunk[n++] = '\0';
        demo_con_scroll();
        for (n = 0; n <= CON_COLS; n++)
            s_con[CON_ROWS - 1][n] = chunk[n];
        if (line[pos] == '\0')
            break;
    }
    s_con_dirty = 1;
}

/* Drain the console ring: assemble complete ('\n'-terminated) lines and
 * push them. Incomplete trailing content stays buffered (s_con_pending). */
static void demo_con_drain(void)
{
    int c;

    while ((c = console_getc()) >= 0) {
        if (c == '\n') {
            s_con_pending[s_con_pending_len] = '\0';
            demo_con_push(s_con_pending);
            s_con_pending_len = 0;
        } else if (s_con_pending_len < sizeof(s_con_pending) - 1) {
            s_con_pending[s_con_pending_len++] = (char)c;
        }
    }
}

/* Redraw the console area from the line buffer (clears the region first). */
static void demo_con_redraw(void)
{
    int x, y, r, c;

    for (y = CON_Y0; y < (int)LCD_H; y++)
        for (x = 0; x < (int)LCD_W; x++)
            lcd_fb[y * LCD_W + x] = 0x0000;
    for (r = 0; r < CON_ROWS; r++)
        for (c = 0; c < CON_COLS; c++) {
            char ch = s_con[r][c];
            if (ch >= 0x20 && ch <= 0x7e)
                lcd_putc_console(c * CON_CH_W, CON_Y0 + r * CON_PITCH,
                                 ch, 0xffff, 0x0000);
        }
    s_con_dirty = 0;
}

/* ---- normal screen: top bar (time + battery) + banner + console -------- */

/* Top bar (row y=0-7): RTC time top-left, battery icon + averaged mV
 * top-right, all in the compact 6x8 font. Uses the 60-sample voltage
 * average so the readout eases through USB unplug/replug jumps. The banner
 * title row (y=8+) is NOT touched (it is drawn by demo_redraw_normal). */
static void demo_draw_topbar(void)
{
    char line[12];
    uint32_t raw = battery_read_raw_avg();
    uint32_t mv = battery_mv_from_raw(raw);
    uint32_t chg = battery_read_raw_ch(6);
    rtc_time_t t;
    int i, j;

    for (i = 0; i < 8; i++)
        for (j = 0; j < (int)LCD_W; j++)
            lcd_fb[i * LCD_W + j] = 0x0000;
    demo_draw_battery_icon(battery_level_percent(mv), chg > 30u);
    demo_snprintf(line, sizeof(line), "%lumV", (unsigned long)mv);
    lcd_print_small(56, 0, line, 0xffff, 0x0000);
    if (rtc_get_time(&t) == 0)
        demo_snprintf(line, sizeof(line), "%02u:%02u:%02u",
                      (unsigned)t.hour, (unsigned)t.minute,
                      (unsigned)t.second);
    else
        demo_snprintf(line, sizeof(line), "--:--:--");
    lcd_print_small(0, 0, line, 0xffff, 0x0000);
}

/* Redraw the whole normal screen (black, top bar, banner, console). */
static void demo_redraw_normal(void)
{
    lcd_fill(0x0000);
    demo_draw_topbar();
    lcd_print_small(4, 8, "B310E-OS v0.4", 0xffff, 0x0000);
    demo_con_redraw();
    irq_disable();
    lcd_show();
    irq_enable();
}

/* The 16-channel ADC grid (RSOFT held). Shared by the keypad task (press)
 * and the banner task (per-second refresh while held). */
static void demo_draw_rsoft_grid(void)
{
    unsigned i;

    keypad_pause();
    lcd_fill(0x0000);
    for (i = 0; i < 16; i++) {
        char line[17];
        uint32_t raw = battery_read_raw_ch(i);

        demo_snprintf(line, sizeof(line), "ch%02u:%lumV r%lu", i,
                      (unsigned long)battery_mv_from_raw(raw),
                      (unsigned long)raw);
        lcd_print_small(0, (int)i * 8, line, 0xffff, 0x0000);
    }
    keypad_resume();
}

void demo_banner_task(void *arg)
{
    (void)arg;

    /* Boot-stage print: the FIRST thing the first task does. If the USB
     * console showed "sched: start" but stops here, the freeze is the first
     * ctx_switch (never-fetched Thumb code — the v2-scheduler hazard). */
    kprintf("banner: enter\n");

    /* Boot banner: black, top bar (time + battery), banner title, console. */
    demo_redraw_normal();

    /* QoL: bootstrap a battery-removed (factory-reset) RTC to the build
     * time, so the top bar shows a sane clock until a real source sets it. */
    demo_rtc_build_boot();

    /* First USB line of the new boot path — proof that module_init_all()
     * finished before this task ran (kputc override is live). */
    kprintf("banner: up\n");

    /* Boot-stage print AFTER the first LCD draw. Seeing "banner: redraw"
     * means demo_redraw_normal (battery/RTC/LCD) completed — the freeze is
     * in the loop below (keylight/timer/poll), not the first draw. */
    kprintf("banner: redraw\n");

    /* Hardware-validation hook: light the keypad at boot (dump-mined ANA
     * channel — 0x82001224 bits 4-7/bit5). Confirm the keypad glows; if
     * not, the level/mask decode needs a hardware re-check. */
    led_keylight_set(15);

    /* The torch GPIO sweep is GONE (2026-08-21): it was the prime suspect
     * for the SD-on-DIAL hang — the sweep left gpio N driven HIGH as an
     * output, and if that pin shares a line with an SDIO signal, the
     * SDCLK_EN at sdio_init stage 5 contends with the GPIO driver and
     * kills the phone electrically (diag-sd, no sweep, works). The torch
     * hunt tools (led_torch_probe_next/led_gpio_set) stay in drivers/led.c
     * for a future dedicated session — they are no longer auto-run. */
    {
        uint32_t last = lcd_sys_timer_ms();
        uint32_t dbg_count = 0;
        uint32_t bat_last = lcd_sys_timer_ms();
        uint32_t con_last = lcd_sys_timer_ms();

        for (;;) {
            usb_debug_poll();   /* keep EP2 armed for the whole boot */
            /* USB replug diagnostics: report the whole post-reset SETUP
             * enumeration sequence once the link is healthy again (count
             * changes). The poll stashes the ring WITHOUT kprintf — during
             * EP0 re-enumeration the host is not reading EP3 IN yet. */
            if (usb_debug_replug_diag(NULL, NULL, NULL) != dbg_count) {
                uint32_t lo[4], hi[4], sts[4];
                unsigned i, n;

                dbg_count = usb_debug_replug_diag(lo, hi, sts);
                kprintf("usb: replug #%lu (%u setups)\n",
                        (unsigned long)dbg_count,
                        (unsigned)(dbg_count < 4 ? dbg_count : 4));
                for (i = 0, n = dbg_count < 4 ? dbg_count : 4; i < n; i++)
                    kprintf("  req=0x%08lx len=%lu sts=0x%lx\n",
                            (unsigned long)lo[i],
                            (unsigned long)(hi[i] >> 16),
                            (unsigned long)sts[i]);
            }
            if ((int32_t)(lcd_sys_timer_ms() - last) >= 1500) {
                last = lcd_sys_timer_ms();
                lcd_fb[(LCD_H - 1) * LCD_W + (LCD_W - 1)] ^= 0xffff; /* blink */
                /* Mask the tick around the LCDC DMA: a HELD matrix key +
                 * the tick IRQ + a peripheral op (the LCD refresh) freezes
                 * the phone (HW-verified 2026-08-21). */
                irq_disable();
                lcd_show();
                irq_enable();
            }
            /* Console: drain + redraw on a FAST gate (~200 ms) so new log
             * lines appear with minimal latency. While RSOFT is held the
             * grid takes the screen and is refreshed here instead. */
            if ((int32_t)(lcd_sys_timer_ms() - con_last) >= 200) {
                con_last = lcd_sys_timer_ms();
                demo_con_drain();
                if (s_rsoft_grid) {
                    demo_draw_rsoft_grid();
                    irq_disable();
                    lcd_show();
                    irq_enable();
                } else if (s_con_dirty) {
                    demo_con_redraw();
                    irq_disable();
                    lcd_show();
                    irq_enable();
                }
            }
            /* Top bar (time + battery) on the slow gate (1 s): the 60-sample
             * voltage average needs the 1 s cadence. Skipped while RSOFT is
             * held (the grid owns the screen). */
            if ((int32_t)(lcd_sys_timer_ms() - bat_last) >= 1000) {
                bat_last = lcd_sys_timer_ms();
                if (!s_rsoft_grid) {
                    demo_draw_topbar();
                    irq_disable();
                    lcd_show();
                    irq_enable();
                }
            }
            task_yield();   /* COOPERATIVE: MUST yield or others starve */
        }
    }
}

/* ---- SD boot-path probe (Rockbox groundwork) ----------------------------
 *
 * Validates the FULL sdboot pattern inside os.bin — the same chain
 * Rockbox's bootloader will use: sdio_init -> sdcard_init -> fat_init ->
 * fat_find_path -> fat_read_simple. diag-sd proved the SDIO/MBR half on
 * hardware (os-diag-sd.bin: "card ok, shl=0" + "MBR OK (sig 0xaa55)");
 * this proves the FAT32 layer + file read on a real card from inside the
 * modular OS, with the scheduler + USB logging live.
 *
 * Key-triggered (DIAL): the probe's card-init does bounded SD I/O that
 * would stall the cooperative scheduler for its duration (a missing card
 * degrades to ~tens of ms of bounded polls, never a hang). It waits for a
 * DIAL press, runs once, logs every stage, then exits the task. */

static volatile int s_sd_probe_req;     /* set by the keypad task on DIAL */

static uint8_t s_sd_sector[1024] __attribute__((aligned(32))); /* FAT buf */
static uint8_t s_sd_file[512];                                  /* file buf */

void demo_sd_task(void *arg)
{
    fatdata_t fatdata;
    fat_entry_t *p;
    uint32_t size, n, i;

    (void)arg;
    kprintf("sd: probe armed (press DIAL)\n");

    while (!s_sd_probe_req)
        task_yield();

    /* The whole SDIO probe is a long hardware-critical section (controller
     * reset, 0x8c SDIO pinmux writes, SD power LDOs, card init, FAT reads).
     * The 1 ms tick is FULLY quiesced for its duration (CPU I bit +
     * INT-controller line) and the keypad matrix scan is paused so the
     * keypad poll does not run mid-probe. NOTE: the old "held matrix key
     * during SDIO init hangs the phone" claim was FALSIFIED (2026-08-22) —
     * that hang was our IRQ-dispatcher bug (unregistered pending lines
     * starved the tick), now fixed; holding a key is safe. sys_timer_resume()
     * + irq_enable() + keypad_resume() restore everything on every exit
     * path below. */
    sys_timer_pause();
    irq_disable();
    keypad_pause();
    kprintf("sd: sdio_init\n");
    sdio_init();
    kprintf("sd: sdcard_init\n");
    if (sdcard_init() != 0) {
        keypad_resume();
        irq_enable();
        sys_timer_resume();
        kprintf("sd: no card / init failed\n");
        task_exit();
    }

    fatdata.buf = s_sd_sector;
    if (fat_init(&fatdata, 0) != 0) {
        keypad_resume();
        irq_enable();
        sys_timer_resume();
        kprintf("sd: fat_init failed (not FAT32?)\n");
        task_exit();
    }
    kprintf("sd: fat32 ok\n");

    p = fat_find_path(&fatdata, "ROCKBOX/ROCKBOX.TXT");
    if (p == NULL || (p->entry.attr & FAT_ATTR_DIR)) {
        keypad_resume();
        irq_enable();
        sys_timer_resume();
        kprintf("sd: ROCKBOX.TXT not found\n");
        task_exit();
    }

    size = p->entry.size;
    if (size > sizeof(s_sd_file))
        size = (uint32_t)sizeof(s_sd_file);
    n = fat_read_simple(&fatdata, fat_entry_clust(p), s_sd_file, size);
    keypad_resume();
    irq_enable();
    sys_timer_resume();
    kprintf("sd: read %lu bytes\n", (unsigned long)n);

    kprintf("sd: content: \"");
    for (i = 0; i < n; i++) {
        char c = (char)s_sd_file[i];
        if (c >= 0x20 && c < 0x7f)
            kprintf("%c", c);
        else
            kprintf(".");
    }
    kprintf("\"\n");

    task_exit();
}

/* ---- keypad echo ------------------------------------------------------- */

static int s_torch_on;      /* torch state (STAR key toggle) */

void demo_keypad_task(void *arg)
{
    uint32_t msg;

    (void)arg;

    kprintf("keypad: up\n");

    for (;;) {
        /* Poll FIRST, pop after: keypad_poll() scans the matrix and injects
         * press events into keypad_queue; q_pop() only drains it. Popping
         * before polling would miss presses (the queue is fed by poll). */
        keypad_poll();
        usb_debug_poll();   /* keep EP2 armed: libc_server may connect anytime */

        if (q_pop(&keypad_queue, &msg) == 0) {
            const char *name = key_name_event(msg);

            /* Log to the host console (libc_server) AND the LCD scrolling
             * console (kprintf feeds both). The event encodes
             * press/release: "key: LSOFT_DOWN" on press, "key: LSOFT_UP"
             * on release (END likewise emits END_DOWN then END_UP). */
            kprintf("key: %s\n", name);

            /* Hardware action: vibrate on END key (dump-mined ANA channel —
             * 0x82001240/44, power gate 0x82001154). Press starts it,
             * release stops it. The keypad scan is paused around the
             * ANA/ADI ops so the poll does not interleave with them. */
            if (keypad_event_code(msg) == KEY_END) {
                keypad_pause();
                led_vibrator_set(keypad_event_is_up(msg) ? 0 : 3);
                keypad_resume();
            }

            /* Torch toggle on STAR key press: ANA_LED_CTRL bits 10/11 +
             * 14/15 (dump-mined from the stock torch function @ 0x01A1CE —
             * the "Torch light" app channel). Same pause as the vibrator. */
            if (keypad_event_code(msg) == KEY_STAR &&
                !keypad_event_is_up(msg)) {
                keypad_pause();
                led_keypad_set(!s_torch_on), s_torch_on = !s_torch_on;
                keypad_resume();
            }

            /* SD boot-path probe trigger on DIAL RELEASE (Rockbox
             * groundwork — demo_sd_task validates the sdboot FAT chain on
             * hardware). Release edge keeps the keypad quiescent while the
             * probe runs (it pauses the tick + keypad internally anyway).
             * The old "held key died at sdio stage 5" was the IRQ-dispatcher
             * bug, fixed 2026-08-22 — a held key is now safe. */
            if (keypad_event_code(msg) == KEY_DIAL &&
                keypad_event_is_up(msg))
                s_sd_probe_req = 1;

            /* Audio test beep on LSOFT press: powers the on-die codec,
             * enables the PA, and emits a 440 Hz square wave through the
             * DAC/amp path (drivers/audio.c). The held-key ANA-op rule is
             * intentionally NOT applied here — the "held key hangs" claim
             * is unproven (the SD hang was an IRQ-dispatcher bug, fixed);
             * if a held LSOFT hangs the phone, that is evidence to
             * report, not to paper over. */
            if (keypad_event_code(msg) == KEY_LSOFT &&
                !keypad_event_is_up(msg))
                audio_beep(440, 300);

            /* ADC channel grid while RSOFT is HELD: press shows all 16
             * channels (compact 6x8 font), release restores the normal
             * screen. The banner task keeps the grid refreshed per second
             * while it is held (s_rsoft_grid). */
            if (keypad_event_code(msg) == KEY_RSOFT) {
                if (!keypad_event_is_up(msg)) {
                    s_rsoft_grid = 1;
                    demo_draw_rsoft_grid();
                    irq_disable();
                    lcd_show();
                    irq_enable();
                } else {
                    s_rsoft_grid = 0;
                    demo_redraw_normal();
                }
            }
        }

        task_yield();   /* COOPERATIVE: MUST yield or others starve */
    }
}
