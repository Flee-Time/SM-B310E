/*
 * Stock-firmware DSP call logger: the code that patch.py places in free NOR.
 *
 * Two halves:
 *
 *   Hooks. Each hook stub (generated by patch.py) saves r0-r7 and lr and
 *   calls one of the log_* functions with a pointer to that frame:
 *     f[0..7] = r0..r7 at the hook, f[8] = lr, f[9..] = the hooked
 *     function's own stack (what its prologue pushed).
 *   A hook only copies a 40-byte record into a ring, with interrupts masked
 *   for the copy. It runs in the caller's context (the layer-1 task, the DSP
 *   interrupt), so it must stay short and shallow: the first version
 *   formatted and sent the line right there and crashed the phone at random
 *   (HW, 2026-11-12).
 *
 *   Drain. The stock scheduler's idle loop calls drain() (patch.py points
 *   its empty idle hook here). It turns the waiting records into text lines
 *   in the logger's transmit buffer and sends that buffer on UCOM port 0,
 *   the interface Windows calls "SPRD AT", the way the stock's SIO layer
 *   does: 64 bytes at a time through the stock's port write, the next piece
 *   from the port's transfer-done callback. (Handing the driver the whole
 *   buffer as one transfer, which the stock does on the DIAG port only,
 *   crashed the phone the moment the PC opened the port: HW, 2026-11-12.)
 *   The stock's AT command channel on that port is cut off: its callback is
 *   replaced by ours and its SIO write is swallowed. The debug port ("SPRD
 *   DIAG") is left to the stock's own log.
 *   An interrupt in the idle loop does not return here (ThreadX restarts
 *   the loop), so everything before the commit must be repeatable; the
 *   commit itself runs with interrupts masked. The idle loop is neither a
 *   thread nor an interrupt: nothing here may reach a ThreadX service.
 *
 * A line is ASCII: '~', a tag letter, the tick count of the hook, then hex
 * fields, CR LF (README.md). Both directions are logged: what the ARM hands
 * the DSP (C, F, T) and what it reads back from it (R, A, P, B, M).
 *
 * Memory: the firmware's layer-1 debug ring (0x23a entries of 16 bytes at
 * RING_BASE). The stock writes it only when its assert-mode byte is 1; this
 * phone has 0x35. It is BSS, so it starts as zeros: an empty ring, nothing
 * in flight.
 *
 * Rules for this file: no writable data of its own (it runs from NOR), no
 * library calls, no division.
 *
 * SPDX-License-Identifier: GPL-2.0-or-later
 */
#include <stdint.h>

typedef uint32_t u32;
typedef uint16_t u16;
typedef uint8_t u8;

/* Stock addresses (e52q7a). patch.py checks the bytes at each before use. */
#define UCOM_WRITE_ADDR  0x000426b0u  /* UCOM: send up to 64 bytes (ARM)     */
#define USB_UP_ADDR      0x000209c8u  /* nonzero while the USB service runs  */
#define TICK_ADDR        0x04008954u  /* tick count, in the PSRAM kernel     */
#define UCOM_DEV0        0x04277804u  /* UCOM port 0: state, ..., callback   */
#define SIO_DATA_WRITE   0x04251200u  /* sio_port[COM_DATA].sio_op.write     */
#define DSP_CTRL_PTR     0x0422e598u  /* -> share window control block       */
#define TXDESC_LEN_TABLE 0x000c8988u  /* payload bytes per TX block type     */
#ifndef RING_BASE
#define RING_BASE        0x0423e728u  /* the unused layer-1 debug ring       */
#endif
#define RING_BYTES       0x23a0u

#define THUMB(a) ((a) | 1u)
/* Returns the bytes taken. The driver sends from the caller's buffer, after
 * this returns, and calls the port's event(1) when they are out. */
#define ucom_write ((u32 (*)(u32 port, const void *buf, u32 len))UCOM_WRITE_ADDR)
#define usb_up    ((u32 (*)(void))THUMB(USB_UP_ADDR))
#define tick_now  ((u32 (*)(void))THUMB(TICK_ADDR))

/* stubs.S (ARM mode): mask IRQs and return the old CPSR; put it back. */
u32 irq_save(void);
void irq_restore(u32 cpsr);

struct ucom_dev {             /* ucom_main.c's per-port block, 0x24 bytes */
    u32 state;                /* 2 = the host has opened the port */
    u32 rx[5];
    void *tx_copy;
    u32 (*event)(u32 what);   /* 0 = data received, 1 = transfer done */
    u32 magic;
};
#define DEV0 ((volatile struct ucom_dev *)UCOM_DEV0)
#define UCOM_OPENED 2
#define UCOM_MAGIC 0x53494f49u
#define DSP_PORT 0

#define PAYLOAD_MAX 32
#define CHUNK 30              /* bytes of a long read per record: offset, total, bytes */
struct record {
    u8 tag;
    u8 len;
    u16 spare;
    u32 when;
    u8 data[PAYLOAD_MAX];
};

#define TX_BYTES 0x600u
#define LINE_MAX 96u          /* the longest line, with CR LF and one pad byte */
#define TX_PIECE 64u          /* what the stock sends at once on this port */
#define TX_TIMEOUT_MS 2000u

struct state {
    u32 head;                 /* next record to write */
    u32 tail;                 /* next record to send  */
    u32 dropped;              /* records lost to a full ring */
    u32 tx_busy;              /* a piece is with the USB driver */
    u32 tx_started;           /* its tick */
    u32 tx_len;               /* bytes in tx[] */
    u32 tx_pos;               /* bytes of them handed to the driver */
    u32 spare;
    u8 tx[TX_BYTES];
    struct record rec[];
};

/* The buffer's top is the drain's stack (the idle loop has 200 bytes). */
#define DRAIN_STACK 0x7a0u
#define RECORDS ((RING_BYTES - DRAIN_STACK - sizeof(struct state)) / sizeof(struct record))
#define ST ((struct state *)RING_BASE)

static int host_listening(void)
{
    return DEV0->magic == UCOM_MAGIC && DEV0->state == UCOM_OPENED;
}

/* ---- hooks ---------------------------------------------------------- */

static void put16(u8 *p, u32 value)
{
    p[0] = (u8)value;
    p[1] = (u8)(value >> 8);
}

static void push(char tag, const u8 *data, u32 len)
{
    struct state *s = ST;
    u32 now = tick_now(), cpsr, head, next, i;

    cpsr = irq_save();
    head = s->head;
    if (head >= RECORDS || s->tail >= RECORDS)
        head = s->head = s->tail = 0;
    next = head + 1 == RECORDS ? 0 : head + 1;
    if (next == s->tail) {
        s->dropped++;
    } else {
        struct record *rec = &s->rec[head];

        rec->tag = (u8)tag;
        rec->len = (u8)len;
        rec->when = now;
        for (i = 0; i < len; i++)
            rec->data[i] = data[i];
        s->head = next;
    }
    irq_restore(cpsr);
}

/* A read longer than one record: CHUNK bytes a record, each starting with
 * its offset and the total length. All of them or none. */
static void push_long(char tag, const u8 *data, u32 len)
{
    struct state *s = ST;
    u32 now = tick_now(), cpsr, head, used, need = 0, off, n, i;

    for (off = 0; off < len; off += CHUNK)
        need++;
    cpsr = irq_save();
    head = s->head;
    if (head >= RECORDS || s->tail >= RECORDS)
        head = s->head = s->tail = 0;
    used = head >= s->tail ? head - s->tail : head + RECORDS - s->tail;
    if (used + need > RECORDS - 1) {
        s->dropped += need;
    } else {
        for (off = 0; off < len; off += n) {
            struct record *rec = &s->rec[head];

            n = len - off > CHUNK ? CHUNK : len - off;
            rec->tag = (u8)tag;
            rec->len = (u8)(n + 2);
            rec->when = now;
            rec->data[0] = (u8)off;
            rec->data[1] = (u8)len;
            for (i = 0; i < n; i++)
                rec->data[2 + i] = data[off + i];
            head = head + 1 == RECORDS ? 0 : head + 1;
        }
        s->head = head;
    }
    irq_restore(cpsr);
}

/* post_cmd (FUN_0005f474): r0 = the 5-halfword command. */
void log_cmd(u32 *f)
{
    push('C', (const u8 *)f[0], 10);
}

/* post_fi (FUN_0005ef76): r0 = 11 halfwords, r1 = the 6-byte extension.
 * 217 a second: only while the host reads. */
void log_fi(u32 *f)
{
    u8 d[28];
    const u8 *fi = (const u8 *)f[0], *ext = (const u8 *)f[1];
    u32 i;

    if (!host_listening())
        return;
    for (i = 0; i < 22; i++)
        d[i] = fi[i];
    for (i = 0; i < 6; i++)
        d[22 + i] = ext[i];
    push('F', d, 28);
}

/* tx_desc_post (FUN_0005f332): its prologue pushed r0 = tag, r1 = type;
 * r2 = the block's bytes. */
void log_tx(u32 *f)
{
    u8 d[PAYLOAD_MAX];
    const u8 *data = (const u8 *)f[2];
    u32 n = ((const u8 *)TXDESC_LEN_TABLE)[f[10] & 0xff], i;

    put16(d, f[9]);
    put16(d + 2, f[10]);
    d[4] = (u8)n;
    if (n > PAYLOAD_MAX - 5)
        n = PAYLOAD_MAX - 5;
    for (i = 0; i < n; i++)
        d[5 + i] = data[i];
    push('T', d, 5 + n);
}

/* DSP->ARM message handler (FUN_0003ab0a): code at +0x10, parameter at
 * +0x12, ack at +0x14 (0 while a message waits). Several per frame. */
void log_msg(u32 *f)
{
    const u8 *ctrl = *(const u8 *volatile *)DSP_CTRL_PTR;
    u32 code, ack;

    (void)f;
    if (!ctrl)
        return;
    code = ctrl[0x10] | (u32)ctrl[0x11] << 8;
    ack = ctrl[0x14] | (u32)ctrl[0x15] << 8;
    if (code != 0xffff && (ack || !host_listening()))
        return;
    push('M', ctrl + 0x10, 6);
}

/* SetState (FUN_0002f348): r0 = the new L1 state, r2 = its context. */
void log_state(u32 *f)
{
    u8 d[4];
    const u8 *ctx = (const u8 *)f[2];

    if ((ctx[8] | (u32)ctx[9] << 8) == (f[0] & 0xffff))
        return;
    d[0] = ctx[8];
    d[1] = ctx[9];
    put16(d + 2, f[0]);
    push('S', d, 4);
}

/* What the ARM reads back from the DSP. Each hook sits on the call that
 * copies one entry out of the share window, or just after it; all of them
 * only while the host reads. */

/* RX ring read (FUN_0005f692), its memcpy: r1 = the 72-byte result. */
void log_rx(u32 *f)
{
    if (host_listening())
        push_long('R', (const u8 *)f[1], 72);
}

/* RESP ring read (FUN_0005f722), after the copy: r4 = the 5 halfwords. */
void log_resp(u32 *f)
{
    if (host_listening())
        push('A', (const u8 *)f[4], 10);
}

/* Power-measure read (FUN_0005ed64), its memcpy: r1 = one 8-byte result. */
void log_pm(u32 *f)
{
    if (host_listening())
        push('P', (const u8 *)f[1], 8);
}

/* Bit-error report read (FUN_0005edec), its memcpy: r1 = one 4-byte report. */
void log_bep(u32 *f)
{
    if (host_listening())
        push('B', (const u8 *)f[1], 4);
}

/* usbservice task, a service is starting: r4 = its number. */
void log_hello(u32 *f)
{
    u8 d[2];

    put16(d, f[4]);
    push('H', d, 2);
}

/* ---- the port ------------------------------------------------------- */

/* Hand the driver the next piece of tx[]. Interrupts masked, or in the USB
 * interrupt's bottom half. */
static void send_piece(struct state *s)
{
    u32 n = s->tx_len - s->tx_pos;

    if (n > TX_PIECE)
        n = TX_PIECE;
    if (ucom_write(DSP_PORT, s->tx + s->tx_pos, n) == n) {
        s->tx_pos += n;
        s->tx_started = tick_now();
    } else {
        s->tx_busy = 0;       /* refused: the idle loop tries again */
    }
}

/* UCOM calls this from the USB interrupt's bottom half. */
static u32 port_event(u32 what)
{
    struct state *s = ST;

    if (what == 1 && s->tx_busy) {
        if (s->tx_pos < s->tx_len && s->tx_len <= TX_BYTES)
            send_piece(s);
        else
            s->tx_busy = 0;
    }
    return 0;                 /* received bytes are left unread */
}

/* In place of the AT channel's SIO write: say it went. */
static u32 swallow(u32 port, const void *data, u32 len)
{
    (void)port;
    (void)data;
    return len;
}

/* ---- drain (idle loop) ---------------------------------------------- */

static u8 *hex(u8 *p, u32 value, int digits)
{
    while (digits--) {
        u32 d = (value >> (digits * 4)) & 15;
        *p++ = (u8)(d < 10 ? '0' + d : 'a' + d - 10);
    }
    return p;
}

static u8 *words(u8 *p, const u8 *data, u32 count)
{
    u32 i;

    for (i = 0; i < count; i++) {
        *p++ = ' ';
        p = hex(p, data[i * 2] | (u32)data[i * 2 + 1] << 8, 4);
    }
    return p;
}

static u8 *begin(u8 *p, char tag, u32 when)
{
    *p++ = '~';
    *p++ = (u8)tag;
    *p++ = ' ';
    return hex(p, when, 8);
}

static u8 *newline(u8 *p)
{
    *p++ = '\r';
    *p++ = '\n';
    return p;
}

static u8 *line(u8 *p, const struct record *rec)
{
    u32 i, n;

    p = begin(p, (char)rec->tag, rec->when);
    if (rec->tag == 'F') {
        /* Most of a frame instruction is ffff: a '*' stands for "ffff to
         * the end" (usblog.py writes them out again). */
        n = 14;
        while (n && rec->data[n * 2 - 2] == 0xff && rec->data[n * 2 - 1] == 0xff)
            n--;
        p = words(p, rec->data, n);
        if (n < 14)
            *p++ = '*';
    } else if (rec->tag == 'R') {
        *p++ = ' ';
        p = hex(p, rec->data[0], 2);
        *p++ = ' ';
        p = hex(p, rec->data[1], 2);
        *p++ = ' ';
        for (i = 2; i < rec->len && i < PAYLOAD_MAX; i++)
            p = hex(p, rec->data[i], 2);
    } else if (rec->tag == 'T') {
        p = words(p, rec->data, 2);
        *p++ = ' ';
        p = hex(p, rec->data[4], 2);
        *p++ = ' ';
        for (i = 5; i < rec->len && i < PAYLOAD_MAX; i++)
            p = hex(p, rec->data[i], 2);
    } else if (rec->tag == 'H') {
        p = words(p, rec->data, 1);
        *p++ = ' ';
        *p++ = 'v';
        *p++ = '6';
    } else {
        p = words(p, rec->data, (rec->len > PAYLOAD_MAX ? PAYLOAD_MAX : rec->len) / 2);
    }
    return newline(p);
}

void drain(void)
{
    struct state *s = ST;
    u32 tail = s->tail, head = s->head, lost = s->dropped, cpsr, len;
    u8 *p = s->tx;

    if (!host_listening() || !usb_up() || tail >= RECORDS || head >= RECORDS)
        return;

    /* The stock rebinds the port when it restarts the USB service. */
    if (DEV0->event != port_event) {
        cpsr = irq_save();
        DEV0->event = port_event;
        *(u32 (*volatile *)(u32, const void *, u32))SIO_DATA_WRITE = swallow;
        s->tx_busy = 0;
        irq_restore(cpsr);
    }
    if (s->tx_busy) {
        /* A piece the host never took. */
        if (tick_now() - s->tx_started > TX_TIMEOUT_MS)
            s->tx_busy = 0;
        return;
    }
    if (s->tx_pos < s->tx_len && s->tx_len <= TX_BYTES) {
        /* The rest of a batch whose last piece was refused or timed out. */
        cpsr = irq_save();
        s->tx_busy = 1;
        send_piece(s);
        irq_restore(cpsr);
        return;
    }

    /* Build the batch. Nothing here changes any state but the buffer,
     * which is ours while tx_busy is 0. */
    if (lost) {
        p = begin(p, 'D', tick_now());
        *p++ = ' ';
        p = newline(hex(p, lost, 8));
    }
    while (tail != head && (u32)(p - s->tx) + LINE_MAX <= TX_BYTES) {
        p = line(p, &s->rec[tail]);
        tail = tail + 1 == RECORDS ? 0 : tail + 1;
    }
    len = (u32)(p - s->tx);
    if (!len)
        return;
    if (!(len & (TX_PIECE - 1)))   /* end on a short packet: the host gets it now */
        s->tx[len++] = '\n';

    /* Commit. */
    cpsr = irq_save();
    s->tx_len = len;
    s->tx_pos = 0;
    s->tx_busy = 1;
    s->tail = tail;
    s->dropped -= lost;
    send_piece(s);
    irq_restore(cpsr);
}
